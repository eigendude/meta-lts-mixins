## conf/layer.conf
```bitbake
# We have a conf and classes directory, append to BBPATH
BBPATH .= ":${LAYERDIR}"

# We have a recipes directory, add to BBFILES
BBFILES += "${LAYERDIR}/recipes*/*/*.bb ${LAYERDIR}/recipes*/*/*.bbappend"

BBFILE_COLLECTIONS += "lts-docker-mixin"
BBFILE_PATTERN_lts-docker-mixin := "^${LAYERDIR}/"
BBFILE_PRIORITY_lts-docker-mixin = "6"

LAYERSERIES_COMPAT_lts-docker-mixin = "dunfell"

LAYERDEPENDS_lts-docker-mixin = " \
    core \
    openembedded-layer \
    networking-layer \
    meta-python \
"

PREFERRED_PROVIDER_virtual/runc ?= "runc-opencontainers"
PREFERRED_PROVIDER_virtual/containerd ?= "containerd-opencontainers"
PREFERRED_PROVIDER_virtual/docker ?= "docker-ce"
```
